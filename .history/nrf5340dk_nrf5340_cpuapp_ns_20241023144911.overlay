/ {
    zephyr,user {
        io-channels = <&adc 0>;  // Make sure this matches your ADC device
    };
};

&adc {
    #address-cells = <1>;
    #size-cells = <0>;
    status = "okay";

    channel@0 {
        reg = <0>;
        zephyr,gain = "ADC_GAIN_1_6";
        zephyr,reference = "ADC_REF_INTERNAL";
        zephyr,acquisition-time = <ADC_ACQ_TIME_DEFAULT>;
        zephyr,input-positive = <NRF_SAADC_AIN0>;  // Ensure this matches the correct pin
        zephyr,resolution = <12>;
    };
};
