/ {
    zephyr,user {
        io-channels = <&adc 0>;  // Referencing channel 0 of the ADC
    };
};

&adc {
    #address-cells = <1>;
    #size-cells = <0>;
    status = "okay";
    channel@0 {
        reg = <0>;  // The channel index, since #address-cells = 1 and #size-cells = 0
        zephyr,gain = "ADC_GAIN_1_6";
        zephyr,reference = "ADC_REF_INTERNAL";
        zephyr,acquisition-time = <ADC_ACQ_TIME_DEFAULT>;
        zephyr,input-positive = <NRF_SAADC_AIN0>;  // Pin P0.04 for AIN0
        zephyr,resolution = <12>;
    };
};
